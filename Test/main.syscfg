/**
 * @cliArgs --device "F28004x" --package "F28004x_100PZ" --part "F28004x_100PZ" --context "system" --product "C2000WARE@5.01.00.00"
 * @versions {"tool":"1.19.0+3426"}
 */

/**
 * Import the modules used in this configuration.
 */
const epwm  = scripting.addModule("/driverlib/epwm.js", {}, false);
const epwm1 = epwm.addInstance();
const gpio  = scripting.addModule("/driverlib/gpio.js", {}, false);
const gpio1 = gpio.addInstance();
const sync  = scripting.addModule("/driverlib/sync.js");

/**
 * Write custom configuration values to the imported modules.
 */
const multiplier2         = system.clockTree["PLL_IMULT"];
multiplier2.multiplyValue = 10;

const mux2       = system.clockTree["OSCCLKSRCSEL"];
mux2.inputSelect = "X1_XTAL";

epwm1.$name               = "myEPWM0";
epwm1.epwmTimebase_period = 500;

gpio1.direction         = "GPIO_DIR_MODE_OUT";
gpio1.writeInitialValue = true;
gpio1.$name             = "GPIO0_Output";
gpio1.qualMode          = "GPIO_QUAL_ASYNC";
gpio1.gpioPin.$assign   = "GPIO10";

/**
 * Pinmux solution for unlocked pins/peripherals. This ensures that minor changes to the automatic solver in a future
 * version of the tool will not impact the pinmux you originally saw.  These lines can be completely deleted in order to
 * re-solve from scratch.
 */
epwm1.epwm.$suggestSolution           = "EPWM2";
epwm1.epwm.epwm_aPin.$suggestSolution = "GPIO2";
epwm1.epwm.epwm_bPin.$suggestSolution = "GPIO3";
